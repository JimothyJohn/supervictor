## esp-idf/main/Kconfig.projbuild
```kconfig
menu "Supervictor"
    config SV_HOST
        string "Target host"
        default "supervictor.advin.io"
        help
            Hostname for the cloud API endpoint.

    config SV_WIFI_SSID
        string "WiFi SSID"
        default ""
        help
            SSID of the WiFi network to connect to.

    config SV_WIFI_PASSWORD
        string "WiFi Password"
        default ""
        help
            Password for the WiFi network.
endmenu
```

## esp-idf/sdkconfig.defaults
```kconfig
# Target
CONFIG_IDF_TARGET="esp32c3"

# Partition table
CONFIG_PARTITION_TABLE_CUSTOM=y
CONFIG_PARTITION_TABLE_CUSTOM_FILENAME="partitions.csv"

# Flash
CONFIG_ESPTOOLPY_FLASHSIZE_4MB=y

# TLS / mbedtls
CONFIG_ESP_TLS_USING_MBEDTLS=y
CONFIG_MBEDTLS_KEY_EXCHANGE_RSA=y
CONFIG_MBEDTLS_KEY_EXCHANGE_ECDHE_RSA=y
CONFIG_MBEDTLS_KEY_EXCHANGE_ECDHE_ECDSA=y
CONFIG_MBEDTLS_SSL_PROTO_TLS1_3=y

# Console output over USB-Serial/JTAG (the /dev/cu.usbmodem port)
CONFIG_ESP_CONSOLE_USB_SERIAL_JTAG=y

# FreeRTOS
CONFIG_FREERTOS_HZ=1000

# Stack sizes
CONFIG_ESP_MAIN_TASK_STACK_SIZE=8192
CONFIG_ESP_SYSTEM_EVENT_TASK_STACK_SIZE=4096

# WiFi
CONFIG_SV_WIFI_SSID="TheCage"
CONFIG_SV_WIFI_PASSWORD="2143001929"

# lwIP
CONFIG_LWIP_DNS_MAX_SERVERS=3
```
